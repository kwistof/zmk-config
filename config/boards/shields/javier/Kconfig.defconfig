## config/boards/shields/javier/Kconfig.defconfig
```kconfig
if SHIELD_JAVIER_LEFT

config ZMK_KEYBOARD_NAME
    default "Javier"

config ZMK_SPLIT_ROLE_CENTRAL
    default y

endif

if SHIELD_JAVIER_LEFT || SHIELD_JAVIER_RIGHT

config ZMK_SPLIT
    default y

endif
```

## config/boards/shields/javier/Kconfig.shield
```kconfig
config SHIELD_JAVIER_LEFT
    def_bool $(shields_list_contains,javier_left)

config SHIELD_JAVIER_RIGHT
    def_bool $(shields_list_contains,javier_right)
```
